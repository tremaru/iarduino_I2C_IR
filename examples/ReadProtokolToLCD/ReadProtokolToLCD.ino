// ОПРЕДЕЛЕНИЕ ПРОТОКОЛА ИК ПУЛЬТА ДУ И ВЫВОД ДАННЫХ НА LCD:   // * Строки со звёздочкой являются необязательными.
                                                               //   Библиотека поддерживает пульты использующие протоколы: NEC, SAMSUNG, SHARP, SONY (SIRC12, SIRC15), PHILIPS (RC5, RC5X, RC6), IARDUINO.
#include          <Wire.h>                                     //   Подключаем библиотеку Wire для работы с шиной I2C.
#include          <LiquidCrystal_I2C.h>                        //   Подключаем библиотеку для работы с LCD дисплеем по шине I2C
#include          <iarduino_I2C_IR.h>                          //   Подключаем библиотеку для работы с ИК-приёмником/передатчиком I2C-flash.
LiquidCrystal_I2C lcd(0x27,16,2);                              //   Объявляем  объект lcd для работы с функциями и методами библиотеки LiquidCrystal_I2C, указывая параметры дисплея (адрес I2C = 0x27, количество столбцов = 16, количество строк = 2)
iarduino_I2C_IR   ir (0x09);                                   //   Объявляем  объект ir  для работы с функциями и методами библиотеки iarduino_I2C_IR,   указывая адрес модуля на шине I2C.
                                                               //   Если объявить объект без указания адреса (iarduino_I2C_IR ir;), то адрес будет найден автоматически.
// Определяем вывод кнопки поиска протокола:                   //
const uint8_t     PIN_KEY = 2;                                 //   Кнопка при нажатии соединяет вывод PIN_KEY с GND.
                                                               //
void setup(){                                                  //
     delay(500);                                               // * Ждём завершение переходных процессов связанных с подачей питания.
     pinMode(PIN_KEY, INPUT_PULLUP);                           //   Переводим вывод PIN_KEY в режим входа с подтяжкой.
     ir.begin();                                               //   Инициируем работу с ИК-приёмником/передатчиком I2C-flash.
     lcd.init();                                               //   Инициируем работу с LCD дисплеем.
     lcd.backlight();                                          //   Включаем подсветку LCD дисплея.
     lcd.setCursor(3, 0);                                      //   Устанавливаем курсор в позицию (3 столбец, 0 строка).
     lcd.print("NO SIGNAL!");                                  //   Выводим текст.
//   Указываем модулю искать ИК-протокол:                      //
     ir.seeProtocol_RX();                                      //   Переводим ИК приёмник в режим определения протокола получаемых данных.
}                                                              //
                                                               //
void loop(){                                                   //
//   Читаем данные приёмника:                                  //
     if( ir.check(true) ){                                     //   Если ИК приёмник получил пакет данных (нажимается кнопка ИК пульта) или пакет повтора (удерживается кнопка ИК пульта).
     //  Выводим полученный номер устройства:                  //
         lcd.setCursor(0, 0);                                  //   Устанавливаем курсор в позицию (0 столбец, 0 строка).
         lcd.print("DEV:");                                    //   Выводим текст.
         if( ir.address<0x10 ){lcd.print(0);}                  //   Выводим ведущий 0.
         lcd.print(ir.address,HEX);                            //   Выводим номер ИК устройства.
     //  Выводим протокол используемый при получении данных:   //
         switch(ir.getProtocol_RX()){                          //
             case IR_NEC:      lcd.print("       NEC"); break; //   Обнаружен протокол NEC.
             case IR_SAMSUNG:  lcd.print("   SAMSUNG"); break; //   Обнаружен протокол SAMSUNG.
             case IR_SHARP:    lcd.print("     SHARP"); break; //   Обнаружен протокол SHARP.
             case IR_SIRC12:   lcd.print("    SIRC12"); break; //   Обнаружен протокол SONY.
             case IR_SIRC15:   lcd.print("    SIRC15"); break; //   Обнаружен протокол SONY.
             case IR_RC5:      lcd.print("       RC5"); break; //   Обнаружен протокол PHILIPS.
             case IR_RC5X:     lcd.print("      RC5X"); break; //   Обнаружен протокол PHILIPS.
             case IR_RC6:      lcd.print("       RC6"); break; //   Обнаружен протокол PHILIPS.
             case IR_IARDUINO: lcd.print("  IARDUINO"); break; //   Обнаружен протокол IARDUINO.
             default:          lcd.print("    NONAME");        // * Протокол не обнаружен.
         }                                                     //
     //  Выводим полученную команду устройства:                //
         lcd.setCursor(0, 1);                                  //   Устанавливаем курсор в позицию (0 столбец, 1 строка).
         lcd.print("COM:");                                    //   Выводим текст.
         if( ir.command<0x10 ){lcd.print(0);}                  //   Выводим ведущий 0.
         lcd.print(ir.command,HEX);                            //   Выводим команду ИК устройства.
     //  Выводим флаг нажатия кнопки:                          //
         lcd.print("   KEY ");                                 //   Выводим текст.
     //  Выводим флаг повтора:                                 //
         lcd.print(ir.key_press?"   ":"RPT");                  //   Выводим текст.
     }else{                                                    //
     //  Выводим флаг отсутствия данных:                       //
         lcd.setCursor(9, 1);                                  //   Устанавливаем курсор в позицию (6 столбец, 0 строка).
         lcd.print("   ");                                     //   Выводим пробелы.
     }                                                         //
     delay(50);                                                // * 
//   Если нажата кнопка поиска протокола:                      //
     if( !digitalRead(PIN_KEY) ){                              //   Если вывод PIN_KEY соединён с GND, то ...
         lcd.clear();                                          //   Чистим дисплей.
         lcd.setCursor(3, 0);                                  //   Устанавливаем курсор в позицию (3 столбец, 0 строка).
         lcd.print("NO SIGNAL!");                              //   Выводим текст.
     //  Указываем модулю искать ИК-протокол:                  //
         ir.seeProtocol_RX();                                  //   Переводим ИК приёмник в режим определения протокола получаемых данных.
     //  Ждём пока не будет отпущена кнопка:                   //
         while(!digitalRead(PIN_KEY)){;}                       //
     }                                                         //
}                                                              //